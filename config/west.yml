## config/west.yml
```yaml
manifest:
  remotes:
    - name: zmkfirmware
      url-base: https://github.com/zmkfirmware
    # Additional modules containing boards/shields/custom code can be listed here as well
    # See https://docs.zephyrproject.org/3.2.0/develop/west/manifest.html#projects
  projects:
    - name: zmk
      remote: zmkfirmware
      revision: main
      import: app/west.yml
  self:
    path: config

# tsuru not found here
#manifest:
  #remotes:
    #- name: zmkfirmware
      ##url-base: https://github.com/zmkfirmware
      ## change to ftc for mouse support
      #url-base: https://github.com/ftc/
  #projects:
    #- name: zmk
      #remote: zmkfirmware
      #revision: mouse-ftc # main
      #import: app/west.yml
  #self:
    #path: config
#
```
